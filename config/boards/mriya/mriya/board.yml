## config/boards/mriya/mriya/board.yml
```yaml
boards:
  - name: mriya_left
    vendor: mriya
    socs:
      - name: nrf52840
        variants:
          - name: zmk
  - name: mriya_right
    vendor: mriya
    socs:
      - name: nrf52840
        variants:
          - name: zmk
```
